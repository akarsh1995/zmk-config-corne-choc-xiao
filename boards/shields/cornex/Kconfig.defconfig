## boards/shields/cornex/Kconfig.defconfig
```kconfig
# Copyright (c) 2020 Pete Johanson, Ryan Cross
# SPDX-License-Identifier: MIT

if SHIELD_CORNEX_LEFT
    config ZMK_KEYBOARD_NAME
        default "Cornex"

    config ZMK_SPLIT_ROLE_CENTRAL
        default y
endif

if SHIELD_CORNEX_LEFT || SHIELD_CORNEX_RIGHT

    config ZMK_SPLIT
        default y

endif
```

## boards/shields/cornex/Kconfig.shield
```kconfig
# Copyright (c) 2020 Pete Johanson, Ryan Cross
# SPDX-License-Identifier: MIT

config SHIELD_CORNEX_LEFT
    def_bool $(shields_list_contains,cornex_left)

config SHIELD_CORNEX_RIGHT
    def_bool $(shields_list_contains,cornex_right)
```
